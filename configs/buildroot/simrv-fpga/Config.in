## configs/buildroot/simrv-fpga/rv64_defconfig
```kconfig
BR2_riscv=y
BR2_RISCV_64=y
BR2_riscv_g=y
BR2_RISCV_ISA_RVC=y
BR2_PACKAGE_HOST_LINUX_HEADERS_CUSTOM_6_12=y
BR2_TOOLCHAIN_BUILDROOT_MUSL=y
BR2_GCC_VERSION_13_X=y
BR2_TARGET_GENERIC_HOSTNAME="simrv-fpga"
BR2_TARGET_GENERIC_ISSUE="SimRV FPGA Linux\\n"
BR2_TARGET_GENERIC_GETTY=y
BR2_TARGET_GENERIC_GETTY_PORT="ttyS0"
BR2_TARGET_GENERIC_GETTY_BAUDRATE_115200=y
BR2_TARGET_GENERIC_GETTY_TERM="vt100"
BR2_TARGET_GENERIC_GETTY_OPTIONS=""
BR2_SYSTEM_DHCP="eth0"
BR2_TARGET_ROOTFS_EXT2=y
BR2_TARGET_ROOTFS_EXT2_4=y
BR2_TARGET_ROOTFS_EXT2_SIZE="128M"
BR2_TARGET_ROOTFS_EXT2_LABEL="simrv-root"
BR2_TARGET_ROOTFS_EXT2_MKFS_OPTIONS="-O ^64bit"
BR2_TARGET_ROOTFS_TAR_NONE=y
BR2_ROOTFS_OVERLAY="$(BR2_EXTERNAL_SIMRV_PATH)/rootfs-overlay"
```
